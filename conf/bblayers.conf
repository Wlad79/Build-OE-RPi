## conf/bblayers.conf
```bitbake
# POKY_BBLAYERS_CONF_VERSION is increased each time build/conf/bblayers.conf
# changes incompatibly
POKY_BBLAYERS_CONF_VERSION = "2"

BBPATH = "${TOPDIR}"
# BBFILES ?= ""

BBLAYERS ?= " \
  ${TOPDIR}/../sources/poky/meta \
  ${TOPDIR}/../sources/poky/meta-poky \
  ${TOPDIR}/../sources/poky/meta-yocto-bsp \
  ${TOPDIR}/../sources/meta-kde \
  ${TOPDIR}/../sources/meta-kde4 \
  ${TOPDIR}/../sources/yocto-meta-kf5 \
  ${TOPDIR}/../sources/meta-raspberrypi \
  ${TOPDIR}/../sources/meta-openembedded/meta-networking \
  ${TOPDIR}/../sources/meta-openembedded/meta-python \
  ${TOPDIR}/../sources/openembedded-core \
  ${TOPDIR}/../sources/openembedded-core/meta-oe \
  ${TOPDIR}/../sources/meta-qt5 \
  "

MACHINE ??= "raspberrypi3-64"

#DISTRO_FEATURES += " opengl systemd x11 "
#REQUIRED_DISTRO_FEATURES += " opengl "
#MACHINE_FEATURES += " vc4graphics "
```
